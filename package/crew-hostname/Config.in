## package/crew-hostname/Config.in
```kconfig
config BR2_PACKAGE_CREW_HOSTNAME
	bool "hostname"
	help
	  Docker containers created with Crew will have correct hostnames.

	  https://github.com/michaelshobbs/dokku-hostname
```

## package/crew-link/Config.in
```kconfig
config BR2_PACKAGE_CREW_LINK
	bool "link"
	help
	  Handles docker links within crew.

	  https://github.com/rlaneve/dokku-link
```

## package/crew-volume/Config.in
```kconfig
config BR2_PACKAGE_CREW_VOLUME
	bool "volume"
	help
	  Supports persistent storage volumes within Crew/Dokku.

	  https://github.com/ohardy/dokku-volume
```

## package/crew/Config.in
```kconfig
config BR2_PACKAGE_CREW
	bool "crew"
	depends on BR2_PACKAGE_LXCDOCKER
	select BR2_PACKAGE_PERL
	select BR2_PACKAGE_CURL
	help
	  Container manager for docker.

	  https://github.com/paralin/crew
```

## package/lxcdocker/Config.in
```kconfig
config BR2_PACKAGE_LXCDOCKER
	bool "lxcdocker"
	select BR2_PACKAGE_SQLITE
	select BR2_PACKAGE_UTIL_LINUX
	select BR2_PACKAGE_UTIL_LINUX_BINARIES
	select BR2_PACKAGE_UTIL_LINUX_PIVOT_ROOT
	select BR2_PACKAGE_UTIL_LINUX_MOUNTPOINT
	select BR2_PACKAGE_UTIL_LINUX_MOUNT
	help
	  Application container engine.

	  https://github.com/docker/docker

if BR2_PACKAGE_LXCDOCKER

config BR2_PACKAGE_LXCDOCKER_DAEMON
	bool "docker daemon"
	default y
	help
	  Build the Docker system daemon. If not selected, will build client only.

config BR2_PACKAGE_LXCDOCKER_EXPERIMENTAL
	bool "build experimental features"

if BR2_PACKAGE_LXCDOCKER_DAEMON

config BR2_PACKAGE_LXCDOCKER_DRIVER_BTRFS
	bool "btrfs filesystem driver"
	depends on BR2_USE_WCHAR # btrfs-progs
	depends on BR2_USE_MMU # btrfs-progs
	depends on BR2_TOOLCHAIN_HAS_THREADS # btrfs-progs
	select BR2_PACKAGE_BTRFS_PROGS
	help
	  Build the btrfs filesystem driver for Docker.

config BR2_PACKAGE_LXCDOCKER_DRIVER_OVERLAYFS
	bool "overlayfs filesystem driver"
	help
	  Build the overlayfs filesystem driver for Docker.

config BR2_PACKAGE_LXCDOCKER_DRIVER_AUFS
	bool "aufs filesystem driver"
	depends on BR2_USE_WCHAR # aufs-util
	depends on BR2_USE_MMU # aufs-util
	depends on BR2_TOOLCHAIN_HAS_THREADS # aufs-util
	select BR2_PACKAGE_AUFS_UTIL
	help
	  Build the aufs filesystem driver for Docker.

config BR2_PACKAGE_LXCDOCKER_DRIVER_DEVICEMAPPER
	bool "devicemapper filesystem driver"
	depends on BR2_TOOLCHAIN_HAS_THREADS # lvm2
	depends on BR2_USE_MMU # lvm2
	depends on !BR2_STATIC_LIBS # lvm2
	select BR2_PACKAGE_LVM2
	select BR2_PACKAGE_LVM2_APP_LIBRARY
	help
	  Build the devicemapper filesystem driver for Docker.

config BR2_PACKAGE_LXCDOCKER_DRIVER_VFS
	bool "vfs filesystem driver"
	depends on BR2_USE_WCHAR # gvfs
	depends on BR2_USE_MMU # gvfs
	depends on BR2_TOOLCHAIN_HAS_THREADS # gvfs
	select BR2_PACKAGE_GVFS
	help
	  Build the vfs filesystem driver for Docker.

endif

endif
```
